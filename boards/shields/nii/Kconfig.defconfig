## boards/shields/nii/Kconfig.defconfig
```kconfig
# Copyright (c) 2024 The ZMK Contributors 
# SPDX-License-Identifier: MIT

if SHIELD_NII_LEFT

config ZMK_KEYBOARD_NAME
    default "NII"

config ZMK_SPLIT_ROLE_CENTRAL
    default y

endif

if SHIELD_NII_LEFT || SHIELD_NII_RIGHT

config ZMK_SPLIT
    default y

endif
```

## boards/shields/nii/Kconfig.shield
```kconfig
config SHIELD_NII_LEFT
    def_bool $(shields_list_contains,nii_left)

config SHIELD_NII_RIGHT
    def_bool $(shields_list_contains,nii_right)
```

## config/boards/shields/nii/Kconfig.defconfig
```kconfig
if SHIELD_NII_LEFT

config ZMK_KEYBOARD_NAME
    default "NII"

config ZMK_SPLIT_ROLE_CENTRAL
    default y

endif # SHIELD_NII_LEFT

if SHIELD_NII_LEFT || SHIELD_NII_RIGHT

config ZMK_SPLIT
    default y

endif # SHIELD_NII_LEFT || SHIELD_NII_RIGHT
```
