// /__w/zmk-config-NII/zmk-config-NII/boards/shields/nii/nii_left.overlay
// UPDATED based on translating Old Index numbers (1-14) to actual D-pins (D0-D10)

#include "nii.dtsi" 

&kscan0 {

    col-gpios
        = <&xiao_d 2 (GPIO_ACTIVE_HIGH)> // COL0 (was D7)
        , <&xiao_d 3 (GPIO_ACTIVE_HIGH)> // COL1 (was D8)
        , <&xiao_d 4 (GPIO_ACTIVE_HIGH)> // COL2 (was D9)
        , <&xiao_d 9 (GPIO_ACTIVE_HIGH)> // COL3 (was D4)
        , <&xiao_d 8 (GPIO_ACTIVE_HIGH)> // COL4 (was D3)
        , <&xiao_d 7 (GPIO_ACTIVE_HIGH)> // COL5 (was D2)
        ;

    row-gpios
        = <&xiao_d 10 (GPIO_ACTIVE_HIGH | GPIO_PULL_DOWN)> // ROW0
        , <&xiao_d 6 (GPIO_ACTIVE_HIGH | GPIO_PULL_DOWN)> // ROW1 (was D5)
        , <&xiao_d 1 (GPIO_ACTIVE_HIGH | GPIO_PULL_DOWN)> // ROW2
        , <&xiao_d 0 (GPIO_ACTIVE_HIGH | GPIO_PULL_DOWN)> // ROW3
        ;
};


